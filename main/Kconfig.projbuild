## main/Kconfig.projbuild
```kconfig
menu "Example Configuration"
    config BLE_ADV_NAME
    string "Advertisement name"
    default "BLE_DIS"
    help
      The device name inside advertisement.

    config BLE_SUB_ADV
    string "Subsequent advertisement data"
    default "SUB_ADV"
    help
      The data inside subsequent advertisements.

    config BLE_DIS_INFO
    bool "Settings Device Information"
    default y
    help
      Enable to settings the device information.

endmenu
```

## sdkconfig.defaults
```kconfig
# Override some defaults so BT stack is enabled
# by default in this example

CONFIG_ESPTOOLPY_FLASHSIZE_8MB=y
CONFIG_ESPTOOLPY_FLASHSIZE="8MB"
CONFIG_ESP32_REV_MIN_3=y
CONFIG_ESP32_REV_MIN=3

CONFIG_BT_ENABLED=y
CONFIG_BT_NIMBLE_ENABLED=y

CONFIG_BLE_CONN_MGR_ROLE_PERIPHERAL=y
CONFIG_BLE_DIS=y
CONFIG_BLE_DIS_SERIAL_NUMBER=y
CONFIG_BLE_DIS_FW_REV=y
CONFIG_BLE_DIS_HW_REV=y
CONFIG_BLE_DIS_SW_REV=y
CONFIG_BLE_DIS_PNP=y
CONFIG_BLE_HRS=y
CONFIG_BLE_HRS_BODY_SENSOR_LOCATION=y
CONFIG_BLE_HRS_CONTROL_POINT=y

#
# Partition Table
#
CONFIG_PARTITION_TABLE_CUSTOM=y
CONFIG_PARTITION_TABLE_CUSTOM_FILENAME="partitions.csv"
CONFIG_PARTITION_TABLE_FILENAME="partitions.csv"
CONFIG_PARTITION_TABLE_OFFSET=0xD000
# end of Partition Table

CONFIG_EXAMPLE_CONNECT_WIFI=y
CONFIG_EXAMPLE_WIFI_SSID_PWD_FROM_STDIN=n
CONFIG_EXAMPLE_WIFI_SSID="mahdi-hotspot"
CONFIG_EXAMPLE_WIFI_PASSWORD="aes256aes"
```
